rgb_encoder: rgb_encoder {
    compatible = "zmk,behavior-sensor-rotate";
    #sensor-binding-cells = <0>;
    bindings = <R_RGB_BRI>, <R_RGB_BRD>;
};

scroll_encoder: scroll_encoder {
    compatible = "zmk,behavior-sensor-rotate";
    #sensor-binding-cells = <0>;
    bindings = <U_WH_D>, <U_WH_U>;

    tap-ms = <100>;
};