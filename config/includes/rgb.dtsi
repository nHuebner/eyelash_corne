#include <dt-bindings/zmk/rgb.h>

#define R_RGB_ON &rgb_ug RGB_ON                // RGB_ON	        Turns the RGB feature on
#define R_RGB_OFF &rgb_ug RGB_OFF              // RGB_OFF	        Turns the RGB feature off
#define R_RGB_TOG &rgb_ug RGB_TOG              // RGB_TOG	        Toggles the RGB feature on and off
#define R_RGB_HUI &rgb_ug RGB_HUI              // RGB_HUI	        Increases the hue of the RGB feature
#define R_RGB_HUD &rgb_ug RGB_HUD              // RGB_HUD	        Decreases the hue of the RGB feature
#define R_RGB_SAI &rgb_ug RGB_SAI              // RGB_SAI	        Increases the saturation of the RGB feature
#define R_RGB_SAD &rgb_ug RGB_SAD              // RGB_SAD	        Decreases the saturation of the RGB feature
#define R_RGB_BRI &rgb_ug RGB_BRI              // RGB_BRI	        Increases the brightness of the RGB feature
#define R_RGB_BRD &rgb_ug RGB_BRD              // RGB_BRD	        Decreases the brightness of the RGB feature
#define R_RGB_SPI &rgb_ug RGB_SPI              // RGB_SPI	        Increases the speed of the RGB feature effect's animation
#define R_RGB_SPD &rgb_ug RGB_SPD              // RGB_SPD	        Decreases the speed of the RGB feature effect's animation
#define R_RGB_EFF &rgb_ug RGB_EFF              // RGB_EFF	        Cycles the RGB feature's effect forwards
#define R_RGB_EFR &rgb_ug RGB_EFR              // RGB_EFR	        Cycles the RGB feature's effect reverse
//&rgb_ug RGB_COLOR_HSB      // RGB_COLOR_HSB	Sets a specific HSB (HSV) value for the underglow

#define R_COL_W &rgb_ug RGB_COLOR_HSB 0 0 100
#define R_COL_G &rgb_ug RGB_COLOR_HSB 120 100 100