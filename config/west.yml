## config/west.yml
```yaml
manifest:
  remotes:
    - name: zmkfirmware
      url-base: https://github.com/zmkfirmware
      # Additional modules containing boards/shields/custom code can be listed here as well.
      # See:
      # - https://zmk.dev/docs/features/modules
      # - https://docs.zephyrproject.org/3.5.0/develop/west/manifest.html#projects
    - name: urob
      url-base: https://github.com/urob
    - name: dhruvinsh
      url-base: https://github.com/dhruvinsh
    - name: joelspadin
      url-base: https://github.com/joelspadin
  projects:
    - name: eyelash_corne
      url: https://github.com/a741725193/zmk-new_corne
      revision: main
    - name: zmk
      remote: zmkfirmware
      revision: main
      import: app/west.yml
    # Urob's zmk helpers that contain key position defines
    - name: zmk-helpers
      remote: urob
      revision: main
    # Tri-state behavior to make cmd+tab switching key
    # Used to be a key feature in urob's fork
    - name: zmk-tri-state
      remote: dhruvinsh
      revision: main
    # Local KeyMaps
    - name: zmk-locales
      remote: joelspadin
      revision: main
  self:
    path: config
```
